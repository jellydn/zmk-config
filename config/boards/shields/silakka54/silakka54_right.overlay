#include "silakka54.dtsi"

// Both halves use the same pins, but the right PCB is mirrored: GP7 is its
// outermost column. List the columns inner to outer so that the keymap reads
// left to right.
&default_transform {
    col-offset = <6>;
};

&kscan0 {
    col-gpios
        = <&gpio0 12 GPIO_ACTIVE_HIGH>
        , <&gpio0 11 GPIO_ACTIVE_HIGH>
        , <&gpio0 10 GPIO_ACTIVE_HIGH>
        , <&gpio0  9 GPIO_ACTIVE_HIGH>
        , <&gpio0  8 GPIO_ACTIVE_HIGH>
        , <&gpio0  7 GPIO_ACTIVE_HIGH>
        ;
};
