#include <behaviors.dtsi>
#include <zmk-helpers/helper.h> // Requires zmk-helpers module.
#include <dt-bindings/zmk/keys.h>

// Mouse keys tuned to match QMK/Vial mouse keys with the Vial settings
// (step 8, max speed 10, interval 20 ms, time to max 30; wheel max 8,
// interval 80 ms, time to max 40). ZMK speeds are units per second.
#define ZMK_POINTING_DEFAULT_MOVE_VAL 4000 // 8 px x 10 per 20 ms
#define ZMK_POINTING_DEFAULT_SCRL_VAL 100  // 8 steps per 80 ms
#include <dt-bindings/zmk/pointing.h>

#define DEF 0
#define NAV 1
#define MOUSE 2
#define SYM 3
#define NUM 4
#define FN 5

#define XXX &none
#define ___ &trans

/* Global defaults */

#define QUICK_TAP_MS 200 // Vial quick tap term

// One-shot mods and layers stay active for 5 s, like Vial's one-shot timeout.
&sk {
  release-after-ms = <5000>;
  quick-release;
};

&sl {
  release-after-ms = <5000>;
};

&lt {
  flavor = "balanced";
  tapping-term-ms = <200>;
  quick-tap-ms = <QUICK_TAP_MS>;
};

/* Homerow mods (urob's "timeless" setup) */

// A hold needs a key on the other hand (or a thumb) to resolve as a mod.
// Boards with a number row also count the other hand's number keys.
#ifdef LN0
  #define NUMROW_L LN0 LN1 LN2 LN3 LN4 LN5
  #define NUMROW_R RN0 RN1 RN2 RN3 RN4 RN5
#else
  #define NUMROW_L
  #define NUMROW_R
#endif

#define MAKE_HRM(NAME, HOLD, TAP, TRIGGER_POS)                                 \
  ZMK_HOLD_TAP(NAME, bindings = <HOLD>, <TAP>; flavor = "balanced";            \
               tapping-term-ms = <280>; quick-tap-ms = <QUICK_TAP_MS>;         \
               require-prior-idle-ms = <150>; hold-trigger-on-release;         \
               hold-trigger-key-positions = <TRIGGER_POS>;)

MAKE_HRM(hml, &kp, &kp, KEYS_R NUMROW_R THUMBS) // Left-hand HRMs.
MAKE_HRM(hmr, &kp, &kp, KEYS_L NUMROW_L THUMBS) // Right-hand HRMs.

/* Graphite shifted pairs (Vial key overrides, base layer only) */

#define SHIFT_MORPH(NAME, BINDING, SHIFTED)                                    \
  ZMK_MOD_MORPH(NAME, bindings = <BINDING>, <SHIFTED>;                         \
                mods = <(MOD_LSFT|MOD_RSFT)>;)

SHIFT_MORPH(gr_sqt,   &kp SQT,   &kp UNDER) // ' _
SHIFT_MORPH(gr_comma, &kp COMMA, &kp QMARK) // , ?
SHIFT_MORPH(gr_minus, &kp MINUS, &kp DQT)   // - "
SHIFT_MORPH(gr_fslh,  &kp FSLH,  &kp LT)    // / <

#include "combos.dtsi"
#include "leader.dtsi"

/* Custom behaviors */

// Screenshot of an area to the clipboard (macOS Ctrl+Shift+Cmd+4).
#define SCRSHOT &kp LC(LS(LG(N4)))

// QMK ramps speed linearly to the max: 30 x 20 ms for the pointer,
// 40 x 80 ms for the wheel.
&mmv {
  time-to-max-speed-ms = <600>;
  acceleration-exponent = <1>;
};

&msc {
  time-to-max-speed-ms = <3200>;
  acceleration-exponent = <1>;
};

#define MS_U &mmv MOVE_UP
#define MS_D &mmv MOVE_DOWN
#define MS_L &mmv MOVE_LEFT
#define MS_R &mmv MOVE_RIGHT
#define WH_U &msc SCRL_UP
#define WH_D &msc SCRL_DOWN
#define WH_L &msc SCRL_LEFT
#define WH_R &msc SCRL_RIGHT

/* Keymap */

// Layers are written for the 54-key Silakka54. Each block is one row of one
// half (six keys, or three thumb keys), left to right as on the board. A board
// without a number row or with extra keys defines its own ZMK_BASE_LAYER that
// drops or adds keys before including this file.
#ifndef ZMK_BASE_LAYER
  #define ZMK_BASE_LAYER(name, LN, RN, LT, RT, LM, RM, LB, RB, LH, RH)         \
      ZMK_LAYER(name, LN RN LT RT LM RM LB RB LH RH)
#endif

ZMK_BASE_LAYER(Base,
//╭─────────────┬─────────────┬─────────────┬─────────────┬─────────────┬─────────────╮ ╭─────────────┬─────────────┬─────────────┬─────────────┬─────────────┬─────────────╮
    &kp GRAVE     &kp N1        &kp N2        &kp N3        &kp N4        &kp N5      ,   &kp N6        &kp N7        &kp N8        &kp N9        &kp N0        &kp C_FF    ,
//├─────────────┼─────────────┼─────────────┼─────────────┼─────────────┼─────────────┤ ├─────────────┼─────────────┼─────────────┼─────────────┼─────────────┼─────────────┤
    &kp LBKT      &kp B         &kp L         &kp D         &kp W         &kp Z       ,   &gr_sqt       &kp F         &kp O         &kp U         &kp J         &kp RBKT    ,
//├─────────────┼─────────────┼─────────────┼─────────────┼─────────────┼─────────────┤ ├─────────────┼─────────────┼─────────────┼─────────────┼─────────────┼─────────────┤
    &kp ESC       &hml LGUI N   &hml LALT R   &hml LCTRL T  &hml LSHFT S  &kp G       ,   &kp Y         &hmr RSHFT H  &hmr RCTRL A  &hmr RALT E   &hmr RGUI I   &gr_comma   ,
//├─────────────┼─────────────┼─────────────┼─────────────┼─────────────┼─────────────┤ ├─────────────┼─────────────┼─────────────┼─────────────┼─────────────┼─────────────┤
    &kp F13       &kp Q         &kp X         &kp M         &kp C         &kp V       ,   &kp K         &kp P         &kp DOT       &gr_minus     &gr_fslh      &kp DEL     ,
//╰─────────────┴─────────────┴─────────────┼─────────────┼─────────────┼─────────────┤ ├─────────────┼─────────────┼─────────────┼─────────────┴─────────────┴─────────────╯
                                              &kp EQUAL     &lt NAV SPACE &lt MOUSE TAB,   &lt SYM RET   &lt NUM BSPC  &kp SEMI
//                                          ╰─────────────┴─────────────┴─────────────╯ ╰─────────────┴─────────────┴─────────────╯
)

ZMK_BASE_LAYER(Nav,
//╭─────────────┬─────────────┬─────────────┬─────────────┬─────────────┬─────────────╮ ╭─────────────┬─────────────┬─────────────┬─────────────┬─────────────┬─────────────╮
    XXX           XXX           XXX           XXX           XXX           XXX         ,   XXX           XXX           XXX           XXX           XXX           XXX         ,
//├─────────────┼─────────────┼─────────────┼─────────────┼─────────────┼─────────────┤ ├─────────────┼─────────────┼─────────────┼─────────────┼─────────────┼─────────────┤
    XXX           XXX           XXX           XXX           XXX           XXX         ,   &kp TAB       &kp BSPC      &kp UP        &kp DEL       XXX           XXX         ,
//├─────────────┼─────────────┼─────────────┼─────────────┼─────────────┼─────────────┤ ├─────────────┼─────────────┼─────────────┼─────────────┼─────────────┼─────────────┤
    &kp ESC       &kp LGUI      &kp LALT      &kp LCTRL     &kp LSHFT     XXX         ,   &kp RET       &kp LEFT      &kp DOWN      &kp RIGHT     &kp CAPS      XXX         ,
//├─────────────┼─────────────┼─────────────┼─────────────┼─────────────┼─────────────┤ ├─────────────┼─────────────┼─────────────┼─────────────┼─────────────┼─────────────┤
    XXX           XXX           XXX           XXX           XXX           XXX         ,   &kp ESC       &kp TAB       &kp HOME      &kp END       XXX           &leader     ,
//╰─────────────┴─────────────┴─────────────┼─────────────┼─────────────┼─────────────┤ ├─────────────┼─────────────┼─────────────┼─────────────┴─────────────┴─────────────╯
                                              XXX           ___           XXX         ,   &kp PG_UP     &kp PG_DN     &tog NAV
//                                          ╰─────────────┴─────────────┴─────────────╯ ╰─────────────┴─────────────┴─────────────╯
)

ZMK_BASE_LAYER(Mouse,
//╭─────────────┬─────────────┬─────────────┬─────────────┬─────────────┬─────────────╮ ╭─────────────┬─────────────┬─────────────┬─────────────┬─────────────┬─────────────╮
    XXX           XXX           XXX           XXX           XXX           XXX         ,   XXX           XXX           XXX           XXX           XXX           XXX         ,
//├─────────────┼─────────────┼─────────────┼─────────────┼─────────────┼─────────────┤ ├─────────────┼─────────────┼─────────────┼─────────────┼─────────────┼─────────────┤
    XXX           XXX           &kp LG(W)     &kp LG(C)     &kp LG(V)     &kp LG(X)   ,   &kp TAB       XXX           MS_U          XXX           XXX           XXX         ,
//├─────────────┼─────────────┼─────────────┼─────────────┼─────────────┼─────────────┤ ├─────────────┼─────────────┼─────────────┼─────────────┼─────────────┼─────────────┤
    &kp ESC       &kp LGUI      &kp LALT      &kp LCTRL     &kp LSHFT     SCRSHOT     ,   &kp RET       MS_L          MS_D          MS_R          XXX           XXX         ,
//├─────────────┼─────────────┼─────────────┼─────────────┼─────────────┼─────────────┤ ├─────────────┼─────────────┼─────────────┼─────────────┼─────────────┼─────────────┤
    XXX           XXX           &kp LG(Q)     &kp LG(S)     &kp LG(A)     &sl FN      ,   &kp ESC       WH_L          WH_D          WH_U          WH_R          XXX         ,
//╰─────────────┴─────────────┴─────────────┼─────────────┼─────────────┼─────────────┤ ├─────────────┼─────────────┼─────────────┼─────────────┴─────────────┴─────────────╯
                                              XXX           XXX           ___         ,   &mkp LCLK     &mkp RCLK     &tog MOUSE
//                                          ╰─────────────┴─────────────┴─────────────╯ ╰─────────────┴─────────────┴─────────────╯
)

// Shifted copy of the Num layer.
ZMK_BASE_LAYER(Sym,
//╭─────────────┬─────────────┬─────────────┬─────────────┬─────────────┬─────────────╮ ╭─────────────┬─────────────┬─────────────┬─────────────┬─────────────┬─────────────╮
    XXX           XXX           XXX           XXX           XXX           XXX         ,   XXX           XXX           XXX           XXX           XXX           XXX         ,
//├─────────────┼─────────────┼─────────────┼─────────────┼─────────────┼─────────────┤ ├─────────────┼─────────────┼─────────────┼─────────────┼─────────────┼─────────────┤
    XXX           &kp LBRC      &kp AMPS      &kp STAR      &kp LPAR      &kp RBRC    ,   XXX           XXX           XXX           XXX           XXX           XXX         ,
//├─────────────┼─────────────┼─────────────┼─────────────┼─────────────┼─────────────┤ ├─────────────┼─────────────┼─────────────┼─────────────┼─────────────┼─────────────┤
    XXX           &kp COLON     &kp DLLR      &kp PRCNT     &kp CARET     &kp PLUS    ,   &kp RET       &kp RSHFT     &kp RCTRL     &kp RALT      &kp RGUI      XXX         ,
//├─────────────┼─────────────┼─────────────┼─────────────┼─────────────┼─────────────┤ ├─────────────┼─────────────┼─────────────┼─────────────┼─────────────┼─────────────┤
    &leader       &kp TILDE     &kp EXCL      &kp AT        &kp HASH      &kp PIPE    ,   &kp ESC       &kp LT        &kp GT        &kp QMARK     XXX           XXX         ,
//╰─────────────┴─────────────┴─────────────┼─────────────┼─────────────┼─────────────┤ ├─────────────┼─────────────┼─────────────┼─────────────┴─────────────┴─────────────╯
                                              &kp LPAR      &kp RPAR      &kp UNDER   ,   ___           XXX           XXX
//                                          ╰─────────────┴─────────────┴─────────────╯ ╰─────────────┴─────────────┴─────────────╯
)

ZMK_BASE_LAYER(Num,
//╭─────────────┬─────────────┬─────────────┬─────────────┬─────────────┬─────────────╮ ╭─────────────┬─────────────┬─────────────┬─────────────┬─────────────┬─────────────╮
    XXX           XXX           XXX           XXX           XXX           XXX         ,   XXX           XXX           XXX           XXX           XXX           XXX         ,
//├─────────────┼─────────────┼─────────────┼─────────────┼─────────────┼─────────────┤ ├─────────────┼─────────────┼─────────────┼─────────────┼─────────────┼─────────────┤
    XXX           &kp LBKT      &kp N7        &kp N8        &kp N9        &kp RBKT    ,   XXX           XXX           XXX           XXX           XXX           XXX         ,
//├─────────────┼─────────────┼─────────────┼─────────────┼─────────────┼─────────────┤ ├─────────────┼─────────────┼─────────────┼─────────────┼─────────────┼─────────────┤
    XXX           &kp SEMI      &kp N4        &kp N5        &kp N6        &kp EQUAL   ,   &kp RET       &kp RSHFT     &kp RCTRL     &kp RALT      &kp RGUI      XXX         ,
//├─────────────┼─────────────┼─────────────┼─────────────┼─────────────┼─────────────┤ ├─────────────┼─────────────┼─────────────┼─────────────┼─────────────┼─────────────┤
    &leader       &kp GRAVE     &kp N1        &kp N2        &kp N3        &kp BSLH    ,   &kp ESC       &kp COMMA     &kp DOT       &kp FSLH      XXX           XXX         ,
//╰─────────────┴─────────────┴─────────────┼─────────────┼─────────────┼─────────────┤ ├─────────────┼─────────────┼─────────────┼─────────────┴─────────────┴─────────────╯
                                              &kp N9        &kp N0        &kp MINUS   ,   XXX           ___           XXX
//                                          ╰─────────────┴─────────────┴─────────────╯ ╰─────────────┴─────────────┴─────────────╯
)

ZMK_BASE_LAYER(Fn,
//╭─────────────┬─────────────┬─────────────┬─────────────┬─────────────┬─────────────╮ ╭─────────────┬─────────────┬─────────────┬─────────────┬─────────────┬─────────────╮
    XXX           XXX           XXX           XXX           XXX           XXX         ,   XXX           XXX           XXX           XXX           XXX           XXX         ,
//├─────────────┼─────────────┼─────────────┼─────────────┼─────────────┼─────────────┤ ├─────────────┼─────────────┼─────────────┼─────────────┼─────────────┼─────────────┤
    XXX           &kp F12       &kp F7        &kp F8        &kp F9        &kp C_MUTE  ,   XXX           &kp C_PREV    &kp C_PP      &kp C_NEXT    XXX           XXX         ,
//├─────────────┼─────────────┼─────────────┼─────────────┼─────────────┼─────────────┤ ├─────────────┼─────────────┼─────────────┼─────────────┼─────────────┼─────────────┤
    XXX           &kp F11       &kp F4        &kp F5        &kp F6        &kp C_VOL_UP,   XXX           &kp RSHFT     &kp RCTRL     &kp RALT      &kp RGUI      XXX         ,
//├─────────────┼─────────────┼─────────────┼─────────────┼─────────────┼─────────────┤ ├─────────────┼─────────────┼─────────────┼─────────────┼─────────────┼─────────────┤
    XXX           &kp F10       &kp F1        &kp F2        &kp F3        &kp C_VOL_DN,   XXX           XXX           XXX           XXX           XXX           XXX         ,
//╰─────────────┴─────────────┴─────────────┼─────────────┼─────────────┼─────────────┤ ├─────────────┼─────────────┼─────────────┼─────────────┴─────────────┴─────────────╯
                                              &kp F13       &kp SPACE     &kp TAB     ,   XXX           XXX           &tog FN
//                                          ╰─────────────┴─────────────┴─────────────╯ ╰─────────────┴─────────────┴─────────────╯
)

/* vim: set ft=c tw=146: */
